/* ---------------------------- Libraries ----------------------------  */
#include <Adafruit_GFX.h>
#include "Adafruit_Si7021.h"
#include <Adafruit_SSD1306.h>
/* ----------------------------- Display Defines ----------------------------- */
#define SCREEN_WIDTH 128 // OLED display width, in pixels
#define SCREEN_HEIGHT 64 // OLED display height, in pixels
#define OLED_MOSI 9
#define OLED_CLK 10
#define OLED_DC 11
#define OLED_CS 12
#define OLED_RESET 13
Adafruit_SSD1306 display(SCREEN_WIDTH, SCREEN_HEIGHT, OLED_MOSI, OLED_CLK,OLED_DC, OLED_RESET, OLED_CS);
 /* ------------------------------Other Defines and Sensor Init------------------------- */
#define DimmPin 8 // possible dimming feature?
Adafruit_Si7021 sensor = Adafruit_Si7021();
/* ---------------------HT icon, I recomend to comment it out  ----------------------- */
// HT_icon, 65x49px
const unsigned char HT [] PROGMEM = {
	0x00, 0x0f, 0xfc, 0x00, 0x70, 0x00, 0x00, 0x03, 0x80, 0x80, 0x1f, 0xfe, 0x00, 0xf0, 0x00, 0x00, 
	0x03, 0x80, 0x8e, 0x1f, 0xfe, 0x38, 0xf3, 0x00, 0xe0, 0x33, 0x80, 0x84, 0x1f, 0xfe, 0x10, 0xf2, 
	0x00, 0x40, 0x13, 0x80, 0xf4, 0xff, 0xff, 0x93, 0xf2, 0x7e, 0x5f, 0xd3, 0x80, 0xf4, 0xff, 0xff, 
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	0x1f, 0xfe, 0x00, 0xff, 0xf0, 0x03, 0xff, 0x80, 0xff, 0xff, 0xff, 0xff, 0xff, 0xff, 0xff, 0xff, 
	0x80
};
void setup() {
  Serial.begin(9600);
  pinMode(DimmPin, INPUT);
  if (!display.begin(SSD1306_SWITCHCAPVCC)) {
    Serial.println(F("SSD1306 allocation failed"));
    for (;;)
      ; 
  }
  display.clearDisplay();
  display.display();
  delay(2000);
}

void loop() {
  DrawHumidityTempr();
  delay(1000);
}

void DrawHumidityTempr(void) {

  display.clearDisplay();
  /* =================================== */
  // Draws Sensor Temperature
  display.setCursor(0, 0);
  display.setTextSize(1);
  display.setTextColor(SSD1306_WHITE);
  display.setCursor(0, 0);
  display.print(F("Temperature:"));
  display.print(sensor.readTemperature());
  /* ===================================== */
  // Draws Humidity
  display.setCursor(0, 10);
  display.setTextSize(2);
  display.setTextColor(SSD1306_WHITE);
  display.print(sensor.readHumidity());
  display.print(F("%"));
  /* =================================== */
  // Different Humidtiy levels means differrent text at the bottom of the screen
  if (sensor.readHumidity() < 50) {
    display.setCursor(0, 45);
    display.setTextSize(3);
    display.setTextColor(SSD1306_BLACK, SSD1306_WHITE);
    display.print(F("LOW"));
  }
  if (sensor.readHumidity() > 55) {
    display.setCursor(0, 45);
    display.setTextSize(3);
    display.setTextColor(SSD1306_BLACK, SSD1306_WHITE);
    display.print(F("HIGH"));
  } else if (sensor.readHumidity() == 50) {
    display.setCursor(0, 45);
    display.setTextSize(3);
    display.setTextColor(SSD1306_BLACK, SSD1306_WHITE);
    display.println(F("OK"));
  }
  /* =================================== */
  // Some icon so it won't be boring to look at 
   display.drawBitmap(65, 25, HT, 65, 41, WHITE);
  /* =================================== */ 
  display.display();
}